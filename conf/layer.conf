## conf/layer.conf
```bitbake
# We have a conf and classes directory, add to BBPATH
BBPATH .= ":${LAYERDIR}"

# We have recipes-* directories, add to BBFILES
BBFILES += "${LAYERDIR}/recipes-*/*/*.bb \
	${LAYERDIR}/recipes-*/*/*.bbappend"

LICENSE_PATH += "${LAYERDIR}/licenses"

BBFILE_COLLECTIONS += "bacnet"
BBFILE_PATTERN_bacnet = "^${LAYERDIR}/"
BBFILE_PRIORITY_bacnet = "6"

LAYERSERIES_COMPAT_bacnet = "sumo"
```
